## nuttx_BeagleBoneBlack/CC8_PROGRAMS/Kconfig
```kconfig
menu "CC8 PROGRAMS"
source "/home/regis/Desktop/nuttxspace/apps/examples/CC8_PROGRAMS/lab1_client/Kconfig"
source "/home/regis/Desktop/nuttxspace/apps/examples/CC8_PROGRAMS/lab1_server/Kconfig"
source "/home/regis/Desktop/nuttxspace/apps/examples/CC8_PROGRAMS/lab7_client/Kconfig"
source "/home/regis/Desktop/nuttxspace/apps/examples/CC8_PROGRAMS/lab_serial_client/Kconfig"
source "/home/regis/Desktop/nuttxspace/apps/examples/CC8_PROGRAMS/lab_serial_server/Kconfig"

endmenu
```

## nuttx_BeagleBoneBlack/apps/examples/rawsock/Kconfig
```kconfig
config EXAMPLES_RAWSOCK
    bool "Ejemplo RAW Socket"
    default n
    help
        Un ejemplo mínimo de uso de socket RAW en loopback.
```

## nuttx_ESP32S3_N8R8/CC8_PROGRAMS/client_udp/Kconfig
```kconfig
# Kconfig for "a la antigua" build style
config Client_UDP
	bool "Client UDP"
	default n
	depends on NET_UDP && NET_IPv4
```

## nuttx_ESP32S3_N8R8/CC8_PROGRAMS/lab1_server/Kconfig
```kconfig
config Lab1_CC8_server
    bool "Lab1_CC8_server"
    default n
    depends on BUILD_FLAT || BUILD_PROTECTED || BUILD_KERNEL
    help
        Muestra un simple mensaje de "Hola Mundo" desde NuttX.
```

## nuttx_ESP32S3_N8R8/CC8_PROGRAMS/raw_sockets/Kconfig
```kconfig
# Kconfig for "a la antigua" build style
config raw_sockets
	bool "raw_sockets"
	default n
```

## nuttx_ESP32S3_N8R8/apps/examples/CC8_PROGRAMS/Kconfig
```kconfig
menu "CC8 PROGRAMS"
source "/home/skelett/copy_nuttx/apps/examples/CC8_PROGRAMS/lab1_client/Kconfig"
source "/home/skelett/copy_nuttx/apps/examples/CC8_PROGRAMS/lab1_server/Kconfig"
source "/home/skelett/copy_nuttx/apps/examples/CC8_PROGRAMS/lab7_client_raw/Kconfig"
source "/home/skelett/copy_nuttx/apps/examples/CC8_PROGRAMS/server_udp/Kconfig"
source "/home/skelett/copy_nuttx/apps/examples/CC8_PROGRAMS/client_udp/Kconfig"
source "/home/skelett/copy_nuttx/apps/examples/CC8_PROGRAMS/raw_sockets/Kconfig"
endmenu
```

## nuttx_ESP32S3_N8R8/apps/examples/CC8_PROGRAMS/lab1_client/Kconfig
```kconfig
config Lab1_CC8_client
    bool "Lab1_CC8_client"
    default n
    depends on BUILD_FLAT || BUILD_PROTECTED || BUILD_KERNEL
    help
        Muestra un simple mensaje de "Hola Mundo" desde NuttX.
```

## nuttx_ESP32S3_N8R8/apps/examples/CC8_PROGRAMS/lab7_client_raw/Kconfig
```kconfig
# Kconfig for "a la antigua" build style
config LAB7_CLIENT
	bool "UDP Client Raw Sockets (CC8/lab7)"
	default n
	depends on NET_UDP && NET_IPv4
	---help---
		Enables the custom UDP client for lab7.
		This client manually constructs IP/UDP headers and sends the
		packet via a raw socket. It is intended to be compiled and
		run on a host machine, but is included here for completeness.
```

## nuttx_ESP32S3_N8R8/apps/examples/CC8_PROGRAMS/server_udp/Kconfig
```kconfig
# Kconfig for "a la antigua" build style
config SERVER_UDP
	bool "Server UDP"
	default n
	depends on NET_UDP && NET_IPv4
```
